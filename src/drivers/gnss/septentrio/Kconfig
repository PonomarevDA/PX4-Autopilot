## src/drivers/gnss/septentrio/Kconfig
```kconfig
menuconfig DRIVERS_GNSS_SEPTENTRIO
	bool "Septentrio GNSS receivers"
	default y
	---help---
		Enable support for Septentrio receivers
```

## src/drivers/hygrometer/sht3x/Kconfig
```kconfig
menuconfig DRIVERS_HYGROMETER_SHT3x
	bool "SHT3x temperature and humidity sensor"
	default y
	---help---
		Enable support SHT35 temperature/humidity sensor
```
